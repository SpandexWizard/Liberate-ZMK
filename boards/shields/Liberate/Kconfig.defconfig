## boards/shields/Liberate/Kconfig.defconfig
```kconfig
if SHIELD_LIBERATE_LEFT

# Name must be less than 16 characters long!
config ZMK_KEYBOARD_NAME
    default "Liberate Keyboard"

config ZMK_SPLIT_ROLE_CENTRAL
    default y

endif

if SHIELD_LIBERATE_LEFT || SHIELD_LIBERATE_RIGHT

config ZMK_SPLIT
    default y

endif
```

## boards/shields/Liberate/Kconfig.shield
```kconfig
# No whitespace after the comma or in your part name!
config SHIELD_LIBERATE_LEFT
    def_bool $(shields_list_contains,liberate_left)

# No whitespace after the comma or in your part name!
config SHIELD_LIBERATE_RIGHT
    def_bool $(shields_list_contains,liberate_right)
```
